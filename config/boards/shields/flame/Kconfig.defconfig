## config/boards/shields/flame/Kconfig.defconfig
```kconfig
# Copyright (c) 2020 The ZMK Contributors
# SPDX-License-Identifier: MIT

config ZMK_BLE
	default y

config ZMK_USB
	default y

if SHIELD_FLAME_DONGLE

config ZMK_KEYBOARD_NAME
	default "The Flame Dongle"

endif

if SHIELD_FLAME_LEFT || SHIELD_FLAME_RIGHT

config ZMK_SPLIT
	default y

endif



if SHIELD_FLAME_DONGLE 

config ZMK_SPLIT
	default y

config ZMK_SPLIT_BLE_ROLE_CENTRAL
	default y

endif
```

## config/boards/shields/flame/Kconfig.shield
```kconfig
# Copyright (c) 2020 The ZMK Contributors
# SPDX-License-Identifier: MIT

config SHIELD_FLAME_LEFT
	def_bool $(shields_list_contains,flame_left)

config SHIELD_FLAME_RIGHT
	def_bool $(shields_list_contains,flame_right)

config SHIELD_FLAME_DONGLE
	def_bool $(shields_list_contains,flame_dongle)
```

## config/boards/shields/piano/Kconfig.defconfig
```kconfig
# Copyright (c) 2020 The ZMK Contributors
# SPDX-License-Identifier: MIT

config ZMK_BLE
	default y

config ZMK_USB
	default y

if SHIELD_PIANO_DONGLE || SHIELD_PIANO_NORM_LEFT || SHIELD_PIANO_NORM_RIGHT

config ZMK_KEYBOARD_NAME
	default "The Piano"

endif

if SHIELD_PIANO_DONGLE_LEFT || SHIELD_PIANO_DONGLE_RIGHT || SHIELD_PIANO_NORM_RIGHT

config ZMK_SPLIT
	default y

endif



if SHIELD_PIANO_DONGLE || SHIELD_PIANO_NORM_LEFT

config ZMK_SPLIT
	default y

config ZMK_SPLIT_BLE_ROLE_CENTRAL
	default y

endif
```

## config/boards/shields/piano/Kconfig.shield
```kconfig
# Copyright (c) 2020 The ZMK Contributors
# SPDX-License-Identifier: MIT

config SHIELD_PIANO_DONGLE_LEFT
	def_bool $(shields_list_contains,piano_dongle_left)

config SHIELD_PIANO_DONGLE_RIGHT
	def_bool $(shields_list_contains,piano_dongle_right)

config SHIELD_PIANO_DONGLE
	def_bool $(shields_list_contains,piano_dongle)

config SHIELD_PIANO_NORM_LEFT
	def_bool $(shields_list_contains,piano_norm_left)

config SHIELD_PIANO_NORM_RIGHT
	def_bool $(shields_list_contains,piano_norm_right)
```

## config/west.yml
```yaml
manifest:
  remotes:
    - name: benvallack
      url-base: https://github.com/benvallack
  projects:
    - name: zmk
      remote: benvallack
      revision: repeatrollfix-tapdance-macro-mouse-dongle
      import: app/west.yml
  self:
    path: config
```
